## Kconfig.intel
```kconfig
# Copyright (c) 2020 Intel Corp.
# SPDX-License-Identifier: Apache-2.0

menu "Intel Internal"

rsource "drivers/Kconfig"
rsource "services/Kconfig"
endmenu
```

## boards/arm/ehl_pse_crb/ehl_pse_crb_defconfig
```kconfig
# Copyright (c) 2021 Intel Corporation
#
# SPDX-License-Identifier: Apache-2.0

CONFIG_SOC_ELKHART_LAKE_PSE=y
CONFIG_BOARD_EHL_PSE_CRB=y
CONFIG_ARM_MPU=y
CONFIG_TICKLESS_KERNEL=y
CONFIG_CORTEX_M_SYSTICK=n
CONFIG_SYS_CLOCK_TICKS_PER_SEC=4096
CONFIG_HPET_TIMER=y
CONFIG_ENABLE_HW_PSS_WORKAROUND=y

# Configure IO Peripheral

#UART
#Selecting Uart for Console
#Note:UART driver has to be part of SEDI BSP to support uart console.
CONFIG_PRINTK=y
CONFIG_CONSOLE=y

CONFIG_UART_CONSOLE=y
CONFIG_SERIAL=y
CONFIG_UART_SEDI=y

#Configure float to use the floating point registers
CONFIG_FPU=y

CONFIG_FLASH=n
CONFIG_XIP=n
CONFIG_FLASH_SIZE=0
CONFIG_FLASH_BASE_ADDRESS=0x0


#SIDEBAND
CONFIG_SIDEBAND=y

#TSYNC
CONFIG_TSYNC=y

#Config sys and pmc service
CONFIG_SYS_SERVICE=y
CONFIG_PMC_SERVICE=y
CONFIG_ECLITE_SERVICE=n
CONFIG_PMC_MAX_CLIENT=3

#Config Power Management
CONFIG_PM=y
CONFIG_PM_DEVICE=y
CONFIG_PM_SERVICE=y

#Config DMA
CONFIG_DMA=y
CONFIG_DMA_SEDI=y

#Config Max Threads support
CONFIG_MAX_THREAD_BYTES=4

#Config HECI
CONFIG_HECI=y
CONFIG_HOST_SERVICE=y
CONFIG_HECI_LOG_LEVEL_ERR=y

# Configure IPC
CONFIG_IPC=y
CONFIG_IPC_SEDI=y
CONFIG_IPC_LOG_LEVEL_ERR=y

#Configure User Mode App Framework
CONFIG_USERSPACE=n
CONFIG_USER_APP_FRAMEWORK=n
CONFIG_NUM_USER_APP_AND_SERVICE=4
CONFIG_MAIN_STACK_SIZE=2048
CONFIG_IDLE_STACK_SIZE=2048

# SHELL priority must be lower than (NUM_PREEMPT_PRIORITIES - 1).
# By default SHELL's priority is assigned the lowest. Now here we are
# increasing the priority so that shell doesn't get blocked by other/default 
# apps.
CONFIG_NUM_PREEMPT_PRIORITIES=32
CONFIG_SHELL_THREAD_PRIORITY_OVERRIDE=y
CONFIG_SHELL_THREAD_PRIORITY=29
```

## drivers/Kconfig
```kconfig
# Copyright (c) 2021 Intel Corp.
# SPDX-License-Identifier: Apache-2.0

menu "Device Drivers"

rsource "ethernet/Kconfig"
rsource "timer/Kconfig"
rsource "dma/Kconfig"
rsource "serial/Kconfig"
rsource "spi/Kconfig"
rsource "tgpio/Kconfig"
rsource "qep/Kconfig"

endmenu
```

## drivers/arm/ethernet/Kconfig.eth_phy_marvell
```kconfig
# Kconfig - Marvell Phy driver configuration options

#
# Copyright (c) 2021 Intel Corporation
#
# SPDX-License-Identifier: Apache-2.0
#
menuconfig ETH_PHY_MARVELL
	bool
	prompt "Marvell Phy driver"
	depends on NET_L2_ETHERNET
	default n
	help
	  Enable Marvell Phy driver.

if ETH_PHY_MARVELL
config ETH_PHY_88E1512
	bool
	prompt "Marvell 88E1512 Phy driver"
	select ETH_PHY
	select ETH_PHY_USE_C22
	default n
	help
	  Enable Marvell 88E1512 Phy driver.

config ETH_PHY_88E1512_EEE
	bool "Energy Efficient Ethernet(EEE) enable"
	depends on ETH_PHY_88E1512
	select ETH_PHY_USE_C45
	default n
	help
	  Enable EEE for link speed 100MHz and 1000MHz to
	  help in saving energy or reducing power consumption
	  in the PHY when no data transmission.

config ETH_PHY_88E1512_RGMII_TX_DLY_10
	int "10Mbps TX delay in RGMII mode"
	depends on ETH_PHY_88E1512 && NET_GPTP
	default 6066
	help
	  Marvell 88E1512 RGMII to 10BASE-T Transmit Latency Timing.
	  Default value are the calculated mean value from datasheet
	  chapter 4.13.

config ETH_PHY_88E1512_RGMII_TX_DLY_100
	int "100Mbps TX delay in RGMII mode"
	depends on ETH_PHY_88E1512 && NET_GPTP
	default 657
	help
	  Marvell 88E1512 RGMII to 100BASE-TX Transmit Latency Timing.
	  Default value are the calculated mean value from datasheet
	  chapter 4.13.

config ETH_PHY_88E1512_RGMII_TX_DLY_1000
	int "1Gbps TX delay in RGMII mode"
	depends on ETH_PHY_88E1512 && NET_GPTP
	default 147
	help
	  Marvell 88E1512 RGMII to 1000BASE-T Transmit Latency Timing.
	  Default value are the calculated mean value from datasheet
	  chapter 4.13.

config ETH_PHY_88E1512_SGMII_TX_DLY_10
	int "10Mbps TX delay in SGMII mode"
	depends on ETH_PHY_88E1512 && NET_GPTP
	default 5385
	help
	  Marvell 88E1512 SGMII to 10BASE-T Transmit Latency Timing.
	  Default value are the calculated mean value from datasheet
	  chapter 4.13.

config ETH_PHY_88E1512_SGMII_TX_DLY_100
	int "100Mbps TX delay in SGMII mode"
	depends on ETH_PHY_88E1512 && NET_GPTP
	default 666
	help
	  Marvell 88E1512 SGMII to 100BASE-TX Transmit Latency Timing.
	  Default value are the calculated mean value from datasheet
	  chapter 4.13.

config ETH_PHY_88E1512_SGMII_TX_DLY_1000
	int "1Gbps TX delay in SGMII mode"
	depends on ETH_PHY_88E1512 && NET_GPTP
	default 219
	help
	  Marvell 88E1512 SGMII to 1000BASE-T Transmit Latency Timing.
	  Default value are the calculated mean value from datasheet
	  chapter 4.13.

config ETH_PHY_88E1512_RGMII_RX_DLY_10
	int "10Mbps RX delay in RGMII mode"
	depends on ETH_PHY_88E1512 && NET_GPTP
	default 2130
	help
	  Marvell 88E1512 10BASE-T to RGMII Receive Latency Timing.
	  Default value are the calculated mean value from datasheet
	  chapter 4.13.

config ETH_PHY_88E1512_RGMII_RX_DLY_100
	int "100Mbps RX delay in RGMII mode"
	depends on ETH_PHY_88E1512 && NET_GPTP
	default 362
	help
	  Marvell 88E1512 100BASE-TX to RGMII Receive Latency Timing.
	  Default value are the calculated mean value from datasheet
	  chapter 4.13.

config ETH_PHY_88E1512_RGMII_RX_DLY_1000
	int "1Gbps RX delay in RGMII mode"
	depends on ETH_PHY_88E1512 && NET_GPTP
	default 231
	help
	  Marvell 88E1512 1000BASE-T to RGMII Receive Latency Timing.
	  Default value are the calculated mean value from datasheet
	  chapter 4.13.

config ETH_PHY_88E1512_SGMII_RX_DLY_10
	int "10Mbps RX delay in SGMII mode"
	depends on ETH_PHY_88E1512 && NET_GPTP
	default 5903
	help
	  Marvell 88E1512 10BASE-T to SGMII Receive Latency Timing.
	  Default value are the calculated mean value from datasheet
	  chapter 4.13.

config ETH_PHY_88E1512_SGMII_RX_DLY_100
	int "100Mbps RX delay in SGMII mode"
	depends on ETH_PHY_88E1512 && NET_GPTP
	default 821
	help
	  Marvell 88E1512 100BASE-TX to SGMII Receive Latency Timing.
	  Default value are the calculated mean value from datasheet
	  chapter 4.13.

config ETH_PHY_88E1512_SGMII_RX_DLY_1000
	int "1Gbps RX delay in SGMII mode"
	depends on ETH_PHY_88E1512 && NET_GPTP
	default 344
	help
	  Marvell 88E1512 1000BASE-T to SGMII Receive Latency Timing.
	  Default value are the calculated mean value from datasheet
	  chapter 4.13.

endif
```

## drivers/arm/ethernet/Kconfig.pse_vnic
```kconfig
# Kconfig - PSE VNIC driver configuration options

#
# Copyright (c) 2021 Intel Corporation
#
# SPDX-License-Identifier: Apache-2.0
#

config ETH_PSE_VNIC
	bool "PSE VNIC driver"
	depends on SEDI
	help
	  Enable virtual NIC for PSE.


if ETH_PSE_VNIC
config ETH_PSE_VNIC_MAC0
	hex "MAC Address Byte 0"
	default 0
	range 0 0xff

config ETH_PSE_VNIC_MAC1
	hex "MAC Address Byte 1"
	default 0
	range 0 0xff

config ETH_PSE_VNIC_MAC2
	hex "MAC Address Byte 2"
	default 0
	range 0 0xff

config ETH_PSE_VNIC_MAC3
	hex "MAC Address Byte 3"
	default 0
	range 0 0xff

config ETH_PSE_VNIC_MAC4
	hex "MAC Address Byte 4"
	default 0
	range 0 0xff

config ETH_PSE_VNIC_MAC5
	hex "MAC Address Byte 5"
	default 0
	range 0 0xff

endif
```

## drivers/audio/Kconfig.alc_5660I
```kconfig
#
# Copyright (c) 2021 Intel Corporation
#
# SPDX-License-Identifier: Apache-2.0
#

menuconfig AUDIO_ALC_5660I
	bool "ALC_5660I DAC support"
	depends on I2C && GPIO
	help
	    Enable ALC_5660I support on the selected board

config	ALC_CODEC_ADDR
	int "ALC CODEC I2C Address as Slave device"
	depends on AUDIO_ALC_5660I
	default 28
	help
	    ALC CODEC I2C Address default is 0x1C.

config  ALC_CODEC_I2C_MASTER_NAME
	string "I2C for ALC CODEC device"
	depends on AUDIO_ALC_5660I
	default "I2C_5"
	help
	    Build settings to run on the RVP

config  ALC_CODEC_GPIO_NAME
	string "GPIO Pins Connected ALC CODEC for jack detection"
	depends on AUDIO_ALC_5660I
	default "GPIO_0"
	help
	    Build settings to run on the RVP

config	GPIO_SEDI_0_PINS
	int "GPIO pin number"
	depends on AUDIO_ALC_5660I
	default 30
	help
	    GPIO pin number for detection.

config	GPIO_CODEC_DET_PLUGIN
	bool "CODEC detection plugin"
	depends on AUDIO_ALC_5660I
	help
	    enable CODEC detection on plugin.
```

## drivers/counter/Kconfig
```kconfig
# Kconfig - counter configuration options

#
# Copyright (c) 2021 Intel Corporation
#
# SPDX-License-Identifier: Apache-2.0
#

menuconfig COUNTER
	bool "Counter Drivers"
	help
	  Enable support for counter and timer.

rsource "Kconfig.sedi"
```

## drivers/counter/Kconfig.sedi
```kconfig
# Kconfig - counter configuration options

#
# Copyright (c) 2021 Intel Corporation
#
# SPDX -License-Identifier: Apache-2.0
#

menuconfig COUNTER_PWM_SEDI
	bool "SEDI APB Timer driver"
	depends on COUNTER && PWM_SEDI
	help
	Enable support for DesignWare apb counters in PSE
```

## drivers/dma/Kconfig.sedi
```kconfig
# Kconfig - SEDI DMA configuration options
#
#
# Copyright (c) 2018-2021 Intel Corporation
#
# SPDX-License-Identifier: Apache-2.0
#

menuconfig DMA_SEDI
	bool "Enable SEDI DMA driver"
	select DMA_64BIT
	depends on DMA
	help
	  SEDI DMA driver.

if DMA_SEDI

config DMA_MULTIPLE_BLOCK
	bool "support multiple block (linked list) mode"
	default y
	help
		"support multiple block (linked list) mode"

endif
```

## drivers/gpio/Kconfig
```kconfig
# ELkhart Lake GPIO configuration options

# Copyright (c) 2021 Intel Corporation
# SPDX-License-Identifier: Apache-2.0

menuconfig GPIO_INTEL_EHL
	bool "Intel Elkhart Lake SoC GPIO"
	help
	  This option enables the GPIO driver for Intel Elkhart
	  Lake SoC.

config GPIO_INTEL_EHL_CHECK_PERMS
	bool "Check permissions before manipulating GPIO"
	depends on GPIO_INTEL_EHL
	help
	  This option enables the checks to make sure the GPIO
	  pin can be manipulated. Only if the pin is owned by
	  the host software and its functioning as GPIO, then
	  the driver allows manipulating the pin.
```

## drivers/gpio/Kconfig.sedi
```kconfig
# Kconfig.pse - SEDI GPIO configuration options
#
#
# Copyright (c) 2021 Intel Corporation
#
# SPDX-License-Identifier: Apache-2.0
#

menuconfig GPIO_SEDI
	bool "SEDI GPIO driver"
	help
	  Enable the GPIO driver using the SEDI library.

menuconfig GPIO_TIMED_SEDI
	bool "SEDI Timed GPIO driver"
	help
	Enable the GPIO driver found on Intel Microcontroller
	boards, using the SEDI library.
```

## drivers/i2c/Kconfig
```kconfig
# Kconfig - I2C configuration options

#
# Copyright (c) 2021 Intel Corporation
#
# SPDX-License-Identifier: Apache-2.0
#

#
# I2C options
#

rsource "Kconfig.sedi"
```

## drivers/i2c/Kconfig.sedi
```kconfig
#
# Copyright (c) 2021 Intel Corporation
#
# SPDX-License-Identifier: Apache-2.0
#

# Kconfig - SEDI I2C configuration options

menuconfig I2C_SEDI
	bool "SEDI I2C driver"
	help
	  SEDI I2C driver.
```

## drivers/i2s/Kconfig
```kconfig
# Kconfig - I2S (Inter-IC Sound) driver configuration options
#
# Copyright (c) 2021 Piotr Mienkowski
# SPDX-License-Identifier: Apache-2.0
#

#
# I2S Drivers
#
rsource "Kconfig.sedi"
```

## drivers/i2s/Kconfig.sedi
```kconfig
# Kconfig - PSE I2S configuration options

# Copyright (c) 2021 Intel Corporation
#
# SPDX-License-Identifier: Apache-2.0
#

menuconfig I2S_SEDI
	bool "Intel PSE I2S Bus Driver"
	depends on SEDI && I2S
	help
	  Enable Inter Sound (I2S) bus driver for PSE.

config I2S_SEDI_DMA_NAME
	string "DMA device name"
	default "DMA_0"
	help
	  Name of the DMA device this device driver can use.

config I2S_TIMESTAMP_EN
	bool "Time stamp Logging"
	help
	  Enable or disable time stamp Logging.

config I2S_SEDI_TX_BLOCK_COUNT
	depends on I2S_SEDI
	int "TX queue length"
	default 16
	help
	  The maximum number of blocks that can be accommodated in the Tx queue.

config I2S_SEDI_RX_BLOCK_COUNT
	depends on I2S_SEDI
	int "RX queue length"
	default 16
	help
	  The maximum number of blocks that can be accommodated in the Rx queue.

config EN_I2S_POLLED_IO
	depends on I2S_SEDI
	bool "Enable Polled read/write"
	help
	  Set 1 to Enable Polled read/write.

config DCACHE_I2S_DMA_WRITEBACK
	depends on I2S_SEDI
	bool "Enable Cache invalidate support"
	default y
	help
	  Set 1 to Enable Cache invalidate support.
```

## drivers/ipc/Kconfig.sedi
```kconfig
#
# Copyright (c) 2021 Intel Corporation
#
# SPDX-License-Identifier: Apache-2.0
#

menuconfig IPC_SEDI
	bool "IPC based on SEDI"
```

## drivers/pwm/Kconfig.sedi
```kconfig
# Kconfig.sedi - SEDI PWM configuration options
#
# Copyright (c) 2021 Intel Corporation
#
# SPDX-License-Identifier: Apache-2.0
#

menuconfig PWM_SEDI
	bool "SEDI PWM driver"
	help
	Enable the PWM driver found on Intel Microcontroller
	boards, using the SEDI library.
```

## drivers/qep/Kconfig
```kconfig
# Kconfig - QEP configuration options

#
# Copyright (c) 2018 Intel Corporation
#
# SPDX-License-Identifier: Apache-2.0
#

#
# QEP options
#
menuconfig QEP
	bool "QEP"
	help
	  Enable QPE Driver Configuration

if QEP

# Include these first so that any properties (e.g. defaults) below can be
# overridden (by defining symbols in multiple locations)

config QEP_INIT_PRIORITY
	int "Init priority"
	default 60
	help
	  QEP device driver initialization priority.

config SYS_LOG_QEP_LEVEL
	int "QEP log level"
	depends on SYS_LOG
	default 0
	help
	  Sets log level for QEP drivers.
	  Levels are:
	  - 0 OFF, do not write
	  - 1 ERROR, only write SYS_LOG_ERR
	  - 2 WARNING, write SYS_LOG_WRN in addition to previous level
	  - 3 INFO, write SYS_LOG_INF in addition to previous levels
	  - 4 DEBUG, write SYS_LOG_DBG in addition to previous levels

endif # QEP
```

## drivers/qep/Kconfig.sedi
```kconfig
#
# Copyright (c) 2021 Intel Corporation
#
# SPDX-License-Identifier: Apache-2.0
#

menuconfig QEP_SEDI
	bool "QEP based on SEDI"
```

## drivers/serial/Kconfig
```kconfig
# Kconfig - serial driver configuration options

#
# Copyright (c) 2014-2015 Wind River Systems, Inc.
#
# SPDX-License-Identifier: Apache-2.0
#

rsource "Kconfig.uart_intel"

rsource "Kconfig.sedi"
```
