## drivers/watchdog/Kconfig.sedi
```kconfig
#
# Copyright (c) 2021 Intel Corporation
#
# SPDX-License-Identifier: Apache-2.0
#

menuconfig WDT_SEDI
	bool "Watchdog Driver based on SEDI"
```

## dts/bindings/dma/intel,sedi-dma.yaml
```yaml
# Copyright (c) 2019-2021 Intel Corporation
#
# SPDX-License-Identifier: Apache-2.0
---
description: INTEL SEDI DMA controller.

compatible: "intel,sedi-dma"

include: dma-controller.yaml

properties:
    reg:
      required: true

    interrupts:
      required: true

    peripheral-id:
      type: int
      description: DMA driver peripheral ID
      required: true
...
```

## dts/bindings/gpio/intel,ehl-gpio.yaml
```yaml
# Copyright (c) 2020 Intel Corporation
# SPDX-License-Identifier: Apache-2.0

description: Intel Elkhart Lake GPIO node

compatible: "intel,ehl-gpio"

include: [gpio-controller.yaml, base.yaml]

properties:
    reg:
      required: true

    label:
      required: true

    community_base:
      type: int
      required: true
      description: Base address of the community to which this GPIO belongs to

    group-index:
      type: int
      required: true
      description: Group number for this GPIO entry

    interrupts:
      required: true

    ngpios:
      required: true
      description: Number of pins for this GPIO entry

    pin-offset:
      type: int
      required: true
      description: Pin offset of this GPIO entry

    "#gpio-cells":
      const: 2

gpio-cells:
  - pin
  - flags
```

## dts/bindings/gpio/intel,elkhart-lake-gpio.yaml
```yaml
# Copyright (c) 2021 Intel Corporation
# SPDX-License-Identifier: Apache-2.0

description: |
    Elkhart Lake GPIO Map

    Map from Elkhart Lake GPIO to component GPIO driver instances.

    The Elkhart Lake GPIO architecture provides six controllers each of
    which has more than 32 pins.  To be supported on Zephyr these pins
    must be mapped to sub-devices that have 32 pins each.
    This compatible is used to map the full controller to its
    subdevices.

compatible: "intel,elkhart-lake-gpio"

include: [gpio-nexus.yaml, base.yaml]
```

## dts/bindings/gpio/intel,pse-gpio.yaml
```yaml
description: SEDI GPIO node

include: [gpio-controller.yaml, base.yaml]

compatible: "intel,pse-gpio"
properties:
    reg:
      required: true
    interrupts:
      required: true
    "#gpio-cells":
      const: 2
gpio-cells:
  - pin
  - flags
```

## dts/bindings/i2c/intel,pse-i2c.yaml
```yaml
#
# Copyright (c) 2021 Intel Corporation.
#
# SPDX-License-Identifier: Apache-2.0
#
---
description: Intel I2C controller found on PSE

compatible: "intel,pse-i2c"

include: i2c-controller.yaml

properties:
    reg:
      required: true

    interrupts:
      required: true

    tx_dma_channel:
      required: false
      type: int
      description: If use I2C tx dma method, this is the dma channel for i2C tx.

    rx_dma_channel:
      required: false
      type: int
      description: If use I2C rx dma method, this is the dma channel for rx

    rx_dma_ext_channel:
      required: false
      type: int
      description: If use I2C rx dma method, this is the second dma channel for rx

...
```

## dts/bindings/i2s/intel,pse-i2s.yaml
```yaml
# Copyright (c) 2021, Intel Corporation
# SPDX-License-Identifier: Apache-2.0

description: I2S controller

compatible: "intel,pse-i2s"

include: [i2s-controller.yaml]

properties:
    reg:
      required: true
    interrupts:
      required: true
    peripheral-id:
      type: int
      description: I2S driver peripheral id
      required: true
    i2s-mode:
      type: int
      description: I2S mode 1 = Full Duplex, 0 = Half Duplex
      required: true
    dma-tx-channel:
      type: int
      description: 0 and 2 tx channel
      required: true
    dma-rx-channel:
      type: int
      description: 1 and 3 rx channel
      required: true
    dma-hwid:
      type: int
      description: dma i2s0 and i2s1 hardware id
      required: true
    hw-fifo-addr:
      type: int
      description: i2s hardware tx and rx fifo address
      required: true
```

## dts/bindings/ipc/intel,sedi-ipc.yaml
```yaml
# Copyright (c) 2019-2021 Intel Corporation
#
# SPDX-License-Identifier: Apache-2.0
---
description: INTEL SEDI IPC controller.

compatible: "intel,sedi-ipc"

include: base.yaml

properties:
    reg:
      required: true

    label:
      required: true

    interrupts:
      required: true

    timeout-ms:
      type: int
      required: true
      description: write timeout in ms
...
```

## dts/bindings/pwm/intel,pse-pwm.yaml
```yaml
# Copyright (c) 2021 Intel Corporation
# SPDX-License-Identifier: Apache-2.0

description: INTEL PSE PWM

compatible: "intel,pse-pwm"

include: [base.yaml]

properties:
    reg:
      type: array
      required: true

    peripheral-id:
      type: int
      description: PWM driver peripheral ID
      required: true
```

## dts/bindings/qep/intel,pse-qep.yaml
```yaml
# Copyright (c) 2021 Intel Corporation
# SPDX-License-Identifier: Apache-2.0

description: INTEL PSE QEP

compatible: "intel,pse-qep"

include: [base.yaml]

properties:
    reg:
      type: array
      required: true

    interrupts:
      type: array
      required: true

    peripheral-id:
      type: int
      description: QEP driver peripheral ID
      required: true
```

## dts/bindings/sideband/intel,pse-sideband.yaml
```yaml
# Copyright (c) 2021 Intel Corporation
# SPDX-License-Identifier: Apache-2.0

description: INTEL PSE Sideband

compatible: "intel,pse-sideband"

include: [base.yaml]

properties:
    reg:
      type: array
      required: true

    interrupts:
      type: array
      required: true
```

## dts/bindings/spi/intel,pse-spi.yaml
```yaml
#
# Copyright (c) 2021 Intel Corporation.
#
# SPDX-License-Identifier: Apache-2.0
#
---
description: Intel SPI controller found on PSE

compatible: "intel,pse-spi"

include: spi-controller.yaml

properties:
    reg:
      required: true

    interrupts:
      required: true

    tx_dma_channel:
      required: false
      type: int
      description: If use spi tx dma method, this is the dma channel for tx.

    rx_dma_channel:
      required: false
      type: int
      description: If use spi rx dma method, this is the dma channel for rx.
...
```

## dts/bindings/tgpio/intel,pse-tgpio.yaml
```yaml
# Copyright (c) 2021 Intel Corporation
# SPDX-License-Identifier: Apache-2.0

description: Intel Elkhart Lake TGPIO node

compatible: "intel,pse-tgpio"

include: [base.yaml]

properties:
    reg:
      required: true

    label:
      required: true

    interrupts:
      required: true

    peripheral-id:
      type: int
      description: TGPIO driver peripheral ID
      required: true
```

## dts/bindings/watchdog/intel,pse-watchdog.yaml
```yaml
#
# Copyright (c) 2021 Intel Corporation.
#
# SPDX-License-Identifier: Apache-2.0
#

description: Intel PSE watchdog

compatible: "intel,pse-watchdog"

include: base.yaml

properties:
    reg:
        required: true

    label:
        required: true

    interrupts:
        required: true
```

## modules/hal_intel/Kconfig
```kconfig
# Copyright (c) 2021 Intel Corporation.
# SPDX-License-Identifier: Apache-2.0

config HAS_INTEL
        bool

menu "intel hal drivers"
        depends on HAS_INTEL

config INTEL_DMA
        bool "Enable DMA driver"

endmenu
```

## modules/hal_sedi/Kconfig
```kconfig
# Copyright (c) 2021 Intel Corporation.
# SPDX-License-Identifier: Apache-2.0

config HAS_INTEL
	bool

menu "intel hal drivers"
	depends on HAS_INTEL

config INTEL_DMA
	bool "Enable DMA driver"

config INTEL_UART
	bool "Enable UART driver"

config INTEL_SPI
	bool "Enable SPI driver"

config INTEL_TGPIO
	bool "Enable Time-Aware GPIO driver"

config INTEL_PWM
	bool "Enable PWM driver"

config INTEL_EMMC
	bool "Enable eMMC driver"

config INTEL_CAN
	bool "Enable CAN driver"

config INTEL_IPC
	bool "Enable IPC driver"

endmenu

config HAS_SEDI
	bool

menuconfig SEDI
	bool "SEDI driver support"
	depends on HAS_SEDI
	help
	  automatically set when either of SEDI_LIBRARY is selected.

if HAS_SEDI

config SEDI_LIBRARY
	bool "Enable SEDI drivers using external library"
	select SEDI
	help
	  This option enables SEDI device drivers. These drivers are actually shim
	  drivers based on drivers provided by SEDI BSP. The BSP provides a static
	  library (libsedi) which implements several drivers for peripherals

endif
```
